## lesson-3/coap-server-example/build/Kconfig/Kconfig.shield
```kconfig
osource "e:/projects/estagio/openthread-fund/cli_puro/boards/shields/*/Kconfig.shield"
osource "e:/projects/estagio/openthread-fund/cli-coap/boards/shields/*/Kconfig.shield"
osource "E:/Programas/ncs/v2.3.0/nrf/boards/shields/*/Kconfig.shield"
```

## lesson-3/coap-server-example/build/Kconfig/Kconfig.shield.defconfig
```kconfig
osource "e:/projects/estagio/openthread-fund/cli_puro/boards/shields/*/Kconfig.defconfig"
osource "e:/projects/estagio/openthread-fund/cli-coap/boards/shields/*/Kconfig.defconfig"
osource "E:/Programas/ncs/v2.3.0/nrf/boards/shields/*/Kconfig.defconfig"
```
