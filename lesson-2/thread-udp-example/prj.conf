## CMakeLists.txt
```
# SPDX-License-Identifier: Apache-2.0

cmake_minimum_required(VERSION 3.20.0)
find_package(Zephyr REQUIRED HINTS $ENV{ZEPHYR_BASE})
project(thread-from-blink)

target_sources(app PRIVATE src/main.c)
target_sources(app PRIVATE src/print_ips.c)
```

## prj.conf
```kconfig
CONFIG_GPIO=y


# USB stack and CDC ACM settings
CONFIG_USB_DEVICE_STACK=y
CONFIG_USB_DEVICE_REMOTE_WAKEUP=n
CONFIG_USB_CDC_ACM=y
CONFIG_USB_DEVICE_MANUFACTURER="Nordic Semiconductor ASA"
CONFIG_USB_DEVICE_PRODUCT="nRF52840 Dongle"
CONFIG_USB_DEVICE_VID=0x1915
CONFIG_USB_DEVICE_PID=0x0001
CONFIG_USB_DEVICE_INITIALIZE_AT_BOOT=y
CONFIG_USB_DEVICE_LOG_LEVEL_OFF=y
CONFIG_USB_CDC_ACM_LOG_LEVEL_OFF=y
CONFIG_USB_CDC_ACM_RINGBUF_SIZE=2048

# Console settings
CONFIG_CONSOLE=y
CONFIG_SERIAL=y
CONFIG_UART_CONSOLE=y
CONFIG_UART_INTERRUPT_DRIVEN=y

# Logger settings
CONFIG_LOG=y
CONFIG_LOG_BACKEND_UART=y
CONFIG_LOG_MODE_DEFERRED=y
```

## src/main.c
```c
/*
 * Copyright (c) 2016 Intel Corporation
 *
 * SPDX-License-Identifier: Apache-2.0
 */

#include <zephyr/kernel.h>
#include <zephyr/drivers/gpio.h>
#include "print_ips.h"

#define SW0_NODE	DT_ALIAS(sw0) 
static const struct gpio_dt_spec button = GPIO_DT_SPEC_GET(SW0_NODE, gpios);
static struct gpio_callback button_cb_data;

void button_pressed(const struct device *dev, struct gpio_callback *cb, uint32_t pins)
{
   	printk("seding....");
}

void otStateChanged(otChangedFlags aFlags, void *aContext)
{
	printk("State chaged to %d", aFlags);
	printOtIps(openthread_get_default_instance());
}

int main(void)
{
	int ret;
	
	otInstance *pInstance = openthread_get_default_instance();
	while(pInstance == NULL){
		printk("Waiting for a not null Thread instance...");
		k_msleep(1000);
		pInstance = openthread_get_default_instance();
	}

	// setting a callback function when openthread changes its state
	otSetStateChangedCallback(openthread_get_default_instance(), otStateChanged, NULL);

	if (!device_is_ready(button.port)) {
		return 0;
	}

	ret = gpio_pin_configure_dt(&button, GPIO_INPUT);
	if (ret < 0) {
		return 0;
	}
	/* Configure the interrupt on the button's pin */
	ret = gpio_pin_interrupt_configure_dt(&button, GPIO_INT_EDGE_TO_ACTIVE );

	/* Initialize the static struct gpio_callback variable   */
    gpio_init_callback(&button_cb_data, button_pressed, BIT(button.pin)); 	
	
	/* Add the callback function by calling gpio_add_callback()   */
	 gpio_add_callback(button.port, &button_cb_data);

	return 0;
}
```

## src/print_ips.c
```c
#include "print_ips.h"
LOG_MODULE_REGISTER(print_ips, 3);

const char* getOriginName(int origin) 
{
   switch (origin) 
   {
		case OT_ADDRESS_ORIGIN_DHCPV6: 
			return "OT_ADDRESS_ORIGIN_DHCPV6";
		case OT_ADDRESS_ORIGIN_MANUAL: 
			return "OT_ADDRESS_ORIGIN_MANUAL";
		case OT_ADDRESS_ORIGIN_SLAAC: 
			return "OT_ADDRESS_ORIGIN_SLAAC";
		case OT_ADDRESS_ORIGIN_THREAD: 
			return "OT_ADDRESS_ORIGIN_THREAD";
   }
}

void printOtIps(otInstance *pInstance){

    if(pInstance == NULL){
        printk("otInstance pointer should not be null");
        return;
    }

	otNetifAddress *otAddresses;
	int ipCounter = 1;
	otAddresses = otIp6GetUnicastAddresses(pInstance);

	do{
		char ipv6_addr_str[40];  // Buffer for IPv6 address string representation
		const otIp6Address * ip6Address = &otAddresses->mAddress;

		// Convert the IPv6 address to a string
		snprintf(ipv6_addr_str, sizeof(ipv6_addr_str),
					"%04x:%04x:%04x:%04x:%04x:%04x:%04x:%04x",
					ntohs(ip6Address->mFields.m16[0]),
					ntohs(ip6Address->mFields.m16[1]),
					ntohs(ip6Address->mFields.m16[2]),
					ntohs(ip6Address->mFields.m16[3]),
					ntohs(ip6Address->mFields.m16[4]),
					ntohs(ip6Address->mFields.m16[5]),
					ntohs(ip6Address->mFields.m16[6]),
					ntohs(ip6Address->mFields.m16[7]));

		printk("\n(%d) IPv6 Address origin = %s, valid = %d: %s\n", ipCounter, getOriginName(otAddresses->mAddressOrigin), otAddresses->mValid, ipv6_addr_str);
		otAddresses = otAddresses->mNext;
		ipCounter++;
	}while(otAddresses != NULL);
}
```
